## conf/layer.conf
```bitbake
# We have a conf and classes directory, add to BBPATH
BBPATH .= ":${LAYERDIR}"

# We have recipes-* directories, add to BBFILES
BBFILES += "${LAYERDIR}/recipes-*/*/*.bb \
	${LAYERDIR}/recipes-*/*/*.bbappend"

BBFILE_COLLECTIONS += "genivi-dev-qtas"
BBFILE_PATTERN_genivi-dev-qtas = "^${LAYERDIR}/"
BBFILE_PRIORITY_genivi-dev-qtas = "30"
```
